AUTOSAR XML (schema 4.0)
standard types defined: uint16
package /Vehicle
  impl type Speed: category=VALUE, base-type=uint16
  service interface VehicleService
    methods:
      operation SetSpeed
        arg speed: type=Speed, direction=IN
      operation ResetSpeed
    events:
      data SpeedChanged: type=Speed
    field CurrentSpeed: type=Speed, has-getter=true, has-notifier=true, has-setter=false
  someip service interface deployment VehicleDeployment: service-interface=VehicleService, service-interface-id=0x1234, service-interface-version={major-version=1, minor-version=1}
    someip method deployment SetSpeedDeployment: method=SetSpeed, method-id=5
    someip event deployment SpeedChangedDeployment: event=SpeedChanged, event-id=0x8001
